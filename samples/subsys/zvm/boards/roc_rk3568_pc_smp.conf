## samples/subsys/zvm/boards/roc_rk3568_pc_smp.conf
```kconfig
# Project configuration
# Copyright 2021-2022 HNU


# kernel vm size(1024M virt ram start + size)
# 1024 - 64M Mbit
CONFIG_KERNEL_VM_SIZE=0xC0000000

# vgic device.
CONFIG_VM_VGICV3=y

# vuart device.
CONFIG_VM_VSERIAL=y

# syscon device
CONFIG_VM_SYSCON_CONTROLLER=y

# fiq debugger
CONFIG_VM_FIQ_DEBUGGER=n
CONFIG_VM_CLOCK_SYSTEM_CONTROLLER=y
```
